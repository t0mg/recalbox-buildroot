## package/controlblock/Config.in
```kconfig
config BR2_PACKAGE_CONTROLBLOCK
	bool "controlblock"
	help
		Controlblock driver

		https://github.com/petrockblog/ControlBlockService
```

## package/python-smbus/Config.in
```kconfig
config BR2_PACKAGE_PYTHON_SMBUS
	bool "python-smbus"
	depends on BR2_PACKAGE_PYTHON
	help
	  Python bindings for Linux SMBus access through i2c-dev.

	  www.lm-sensors.org/wiki/I2CTools
```
